## dotsim/hostsim/sdkconfig.defaults
```kconfig
# The sim's own settings, before the app's (app.sdkconfig, made from the app's
# sdkconfig.defaults by build.sh).
CONFIG_IDF_TARGET="linux"
CONFIG_PARTITION_TABLE_CUSTOM=y
CONFIG_PARTITION_TABLE_CUSTOM_FILENAME="sdk/components/kbsp/partitions.csv"
CONFIG_ESPTOOLPY_FLASHSIZE_32MB=y
CONFIG_ESPTOOLPY_FLASHSIZE="32MB"
CONFIG_FREERTOS_HZ=1000
CONFIG_FREERTOS_THREAD_LOCAL_STORAGE_POINTERS=2
CONFIG_FREERTOS_TLSP_DELETION_CALLBACKS=y
CONFIG_ESP_MAIN_TASK_STACK_SIZE=65536
CONFIG_KODEOS_BOOT_ROLE_APP=y
CONFIG_KODEOS_RADIO=n
CONFIG_KODEOS_NFC=n
CONFIG_KODEOS_MIRROR=n
CONFIG_KODEOS_CONSOLE=n
CONFIG_KODE_LOWPOWER=n
CONFIG_KODE_SCHEDULER=n
CONFIG_KODEOS_AUTOTEST=n
CONFIG_KODE_TEST_DOT=n
CONFIG_ESP_HOSTED_ENABLED=n
CONFIG_BT_ENABLED=n
CONFIG_COMPILER_OPTIMIZATION_PERF=y
```
